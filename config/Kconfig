## config/boards/arm/plonck/Kconfig.board
```kconfig
# plonck board configuration

# Copyright (c) 2021 swampmonster
# SPDX-License-Identifier: MIT

config BOARD_PLONCK
	bool "plonck"
	depends on SOC_NRF52840_QIAA
```

## config/boards/arm/plonck/Kconfig.defconfig
```kconfig
# Copyright (c) 2021 swampmonster
# SPDX-License-Identifier: MIT

if BOARD_PLONCK

config BOARD
	default "plonck"

config ZMK_KEYBOARD_NAME
    default "plonck"

if USB

config USB_NRFX
	default y

config USB_DEVICE_STACK
	default y

endif # USB

config BT_CTLR
	default BT

config ZMK_BLE
	default y

config ZMK_USB
	default y
	
config ZMK_BATTERY_VOLTAGE_DIVIDER
	default y

endif # BOARD_PLONCK
```

## config/boards/arm/plonck/Kconfig.plonck
```kconfig
# plonck board configuration

# Copyright (c) 2021 swampmonster
# SPDX-License-Identifier: MIT

config BOARD_PLONCK
	select SOC_NRF52840_QIAA
	select ZMK_BOARD_COMPAT if BOARD_PLONCK_NRF52840_ZMK
	imply RETAINED_MEM if BOARD_PLONCK_NRF52840_ZMK
	imply RETENTION if BOARD_PLONCK_NRF52840_ZMK
	imply RETENTION_BOOT_MODE if BOARD_PLONCK_NRF52840_ZMK
```

## config/boards/arm/plonck/board.yml
```yaml
board:
  name: plonck
  vendor: ardakilic
  socs:
    - name: nrf52840
      variants:
        - name: zmk
```

## config/boards/arm/plonck/plonck_zmk_defconfig
```kconfig
# Copyright (c) 2021 swampmonster
# SPDX-License-Identifier: MIT

# Enable MPU
CONFIG_ARM_MPU=y

# enable GPIO
CONFIG_GPIO=y

CONFIG_USE_DT_CODE_PARTITION=y
CONFIG_BUILD_OUTPUT_UF2=y

CONFIG_MPU_ALLOW_FLASH_WRITE=y
CONFIG_NVS=y
CONFIG_SETTINGS_NVS=y
CONFIG_FLASH=y
CONFIG_FLASH_PAGE_LAYOUT=y
CONFIG_FLASH_MAP=y

CONFIG_CLOCK_CONTROL_NRF=y
CONFIG_CLOCK_CONTROL_NRF_K32SRC_RC=y

# ZMK specific
CONFIG_ZMK_USB=y
CONFIG_ZMK_BLE=y
CONFIG_ZMK_SLEEP=y

# Bootloader Support
CONFIG_RETAINED_MEM=y
CONFIG_RETENTION=y
CONFIG_RETENTION_BOOT_MODE=y
```

## config/boards/shields/corne_tps43/Kconfig.defconfig
```kconfig
# Copyright (c) 2025 The ZMK Contributors
# SPDX-License-Identifier: MIT

if SHIELD_CORNE_TPS43_LEFT

config ZMK_KEYBOARD_NAME
    default "Corne TPS43"

config ZMK_SPLIT_ROLE_CENTRAL
    default y

endif

if SHIELD_CORNE_TPS43_RIGHT

config ZMK_KEYBOARD_NAME
    default "Corne TPS43"

endif

if SHIELD_CORNE_TPS43_LEFT || SHIELD_CORNE_TPS43_RIGHT

config ZMK_SPLIT
    default y

endif 
```

## config/boards/shields/corne_tps43/Kconfig.shield
```kconfig
# Copyright (c) 2025 The ZMK Contributors
# SPDX-License-Identifier: MIT

rsource "../../../drivers/sensor/Kconfig"

config SHIELD_CORNE_TPS43_LEFT
    def_bool $(shields_list_contains,corne_tps43_left)

config SHIELD_CORNE_TPS43_RIGHT
    def_bool $(shields_list_contains,corne_tps43_right) 
```

## config/boards/shields/corne_tps65/Kconfig.defconfig
```kconfig
# Copyright (c) 2025 The ZMK Contributors
# SPDX-License-Identifier: MIT

if SHIELD_CORNE_TPS65_LEFT

config ZMK_KEYBOARD_NAME
    default "Corne TPS65"

config ZMK_SPLIT_ROLE_CENTRAL
    default y

endif

if SHIELD_CORNE_TPS65_RIGHT

config ZMK_KEYBOARD_NAME
    default "Corne TPS65"

# TPS65 sensor is enabled via driver Kconfig

endif

if SHIELD_CORNE_TPS65_LEFT || SHIELD_CORNE_TPS65_RIGHT

config ZMK_SPLIT
    default y

# Disable USB logging to avoid split keyboard conflicts
# config ZMK_USB_LOGGING
#     default y

endif 
```

## config/boards/shields/corne_tps65/Kconfig.shield
```kconfig
# Copyright (c) 2025 The ZMK Contributors
# SPDX-License-Identifier: MIT

rsource "../../../drivers/sensor/Kconfig"

config SHIELD_CORNE_TPS65_LEFT
    def_bool $(shields_list_contains,corne_tps65_left)

config SHIELD_CORNE_TPS65_RIGHT
    def_bool $(shields_list_contains,corne_tps65_right) 
```

## config/boards/shields/istanbul/Kconfig.defconfig
```kconfig
# Copyright (c) 2025 The ZMK Contributors
# SPDX-License-Identifier: MIT

if SHIELD_ISTANBUL_LEFT

config ZMK_KEYBOARD_NAME
    default "Istanbul"

config ZMK_SPLIT_ROLE_CENTRAL
    default y

endif

if SHIELD_ISTANBUL_LEFT || SHIELD_ISTANBUL_RIGHT

config ZMK_SPLIT
    default y

endif
```

## config/boards/shields/istanbul/Kconfig.shield
```kconfig
# Copyright (c) 2025 The ZMK Contributors
# SPDX-License-Identifier: MIT

config SHIELD_ISTANBUL_LEFT
    def_bool $(shields_list_contains,istanbul_left)

config SHIELD_ISTANBUL_RIGHT
    def_bool $(shields_list_contains,istanbul_right)
```

## config/boards/shields/reviung41/Kconfig.shield
```kconfig
# Copyright (c) 2025 The ZMK Contributors
# SPDX-License-Identifier: MIT

rsource "../../../drivers/sensor/Kconfig"
```

## config/drivers/sensor/Kconfig
```kconfig
# SPDX-License-Identifier: MIT

config ZMK_SENSOR_TPS65
	bool "Azoteq TPS-65 Trackpad Support"
	depends on I2C
	help
	  Enable support for Azoteq TPS-65 trackpad modules (43mm and 65mm variants).
	  This driver supports multi-touch, gesture recognition, and coordinate reporting
	  for the IQS5xx-B000 series trackpad controllers.

if ZMK_SENSOR_TPS65

config ZMK_SENSOR_TPS65_GESTURE_SUPPORT
	bool "Enable gesture support"
	default y
	help
	  Enable gesture recognition including swipes, taps, zoom, and scroll gestures.

config ZMK_SENSOR_TPS65_MAX_TOUCHES
	int "Maximum number of simultaneous touches"
	default 5
	range 1 5
	help
	  Maximum number of simultaneous touch points to track. Higher values
	  consume more memory but allow more complex multi-touch gestures.

config ZMK_SENSOR_TPS65_POLL_RATE_MS
	int "Polling rate in milliseconds"
	default 10
	range 5 100
	help
	  How often to poll the trackpad for new data when not using interrupts.
	  Lower values provide better responsiveness but higher power consumption.

config ZMK_SENSOR_TPS65_SENSITIVITY
	int "Touch sensitivity (1-255)"
	default 40
	range 1 255
	help
	  Touch sensitivity threshold. Lower values are more sensitive.
	  Adjust based on overlay thickness and desired sensitivity.

endif # ZMK_SENSOR_TPS65 
```

## config/dts/bindings/sensor/azoteq,tps43.yaml
```yaml
description: Azoteq TPS43 Trackpad with IQS572 controller

compatible: "azoteq,tps43"

include: [sensor-device.yaml, i2c-device.yaml]

properties:
  rdy-gpios:
    type: phandle-array
    description: |
      Ready GPIO. This pin is driven high when the device has data available.

  rst-gpios:
    type: phandle-array
    description: |
      Reset GPIO. This pin is used to reset the device.

  max-x:
    type: int
    default: 2048
    description: |
      Maximum X coordinate value (TPS43 resolution: 2048 x 1792)

  max-y:
    type: int
    default: 1792
    description: |
      Maximum Y coordinate value (TPS43 resolution: 2048 x 1792)

  max-touch-points:
    type: int
    default: 5
    description: |
      Maximum number of simultaneous touches supported

  variant:
    type: string
    default: "43mm"
    description: |
      TPS43 trackpad variant (43mm x 40mm)

  resolution-x:
    type: int
    default: 2048
    description: |
      X-axis resolution in counts per inch

  resolution-y:
    type: int
    default: 1792
    description: |
      Y-axis resolution in counts per inch

  touch-threshold:
    type: int
    default: 40
    description: |
      Touch detection threshold (lower = more sensitive)

  max-touches:
    type: int
    default: 5
    description: |
      Maximum number of simultaneous touches

  palm-reject-threshold:
    type: int
    default: 100
    description: |
      Palm rejection threshold (ignore touches larger than this)

  gesture-enable:
    type: boolean
    description: |
      Enable gesture recognition support

  i2c-timeout-ms:
    type: int
    default: 10
    description: |
      I2C communication timeout in milliseconds 
```

## config/dts/bindings/sensor/azoteq,tps65.yaml
```yaml
# SPDX-License-Identifier: MIT

description: Azoteq TPS-65 Trackpad (IQS5xx-B000 series)

compatible: "azoteq,tps65"

include: [sensor-device.yaml, i2c-device.yaml]

properties:
  variant:
    type: string
    default: "65mm"
    enum:
      - "43mm"
      - "65mm"
    description: |
      Trackpad size variant. Affects coordinate scaling and touch area.
      - 43mm: 43x40mm trackpad module
      - 65mm: 65x49mm trackpad module

  resolution-x:
    type: int
    default: 4096
    description: X-axis resolution (coordinate range 0 to resolution-x)

  resolution-y:
    type: int
    default: 4096
    description: Y-axis resolution (coordinate range 0 to resolution-y)

  invert-x:
    type: boolean
    description: Invert X-axis coordinates

  invert-y:
    type: boolean
    description: Invert Y-axis coordinates

  swap-axes:
    type: boolean
    description: Swap X and Y axes

  rdy-gpios:
    type: phandle-array
    description: |
      GPIO connected to the RDY (ready) pin. When specified, the driver
      will use interrupt-driven mode instead of polling.

  rst-gpios:
    type: phandle-array
    description: |
      GPIO connected to the NRST (reset) pin. Optional for hardware reset control.

  touch-threshold:
    type: int
    default: 40
    description: |
      Touch detection threshold (1-255). Lower values are more sensitive.
      Should be adjusted based on overlay thickness and material.

  gesture-enable:
    type: boolean
    default: true
    description: Enable gesture recognition (swipes, taps, zoom, scroll)

  max-touches:
    type: int
    default: 5
    description: Maximum number of simultaneous touches to track (1-5)

  palm-reject-threshold:
    type: int
    default: 100
    description: |
      Palm rejection threshold. Touches larger than this area will be ignored.
      Set to 0 to disable palm rejection.

  i2c-timeout-ms:
    type: int
    default: 10
    description: I2C communication timeout in milliseconds 
```
