/*
 * TPS65 trackpad on nice_nano_v2 for reviung41
 */

&pro_micro_i2c {
    status = "okay";

    tps65: trackpad@74 {
        compatible = "azoteq,tps65";
        reg = <0x74>;

        /* TPS65 resolution: 3072 x 2048 */
        max-x = <3072>;
        max-y = <2048>;

        /* GPIO connections */
        rdy-gpios = <&pro_micro 4 GPIO_ACTIVE_HIGH>;
        rst-gpios = <&pro_micro 9 GPIO_ACTIVE_HIGH>;

        /* Optional features */
        gesture-enable;
    };
};


